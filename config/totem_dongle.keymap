#include <behaviors.dtsi>

#include <dt-bindings/zmk/keys.h>
#include <dt-bindings/zmk/behaviors.h>

/ {
    keymap {
        compatible = "zmk,keymap";
        layout {
            bindings = <&trans>;
        };
    };
};