#include <dt-bindings/zmk/matrix_transform.h>

/ {
    kscan0: kscan_0 {
        compatible = "zmk,kscan-mock";
        columns = <0>;
        rows = <0>;
        events = <0>;
    };

    chosen {
        zmk,kscan = &kscan0;
    };
};